## config/west.yml
```yaml
manifest:
  remotes:
    - name: zmkfirmware
      url-base: https://github.com/zmkfirmware
      # Additional modules containing boards/shields/custom code can be listed here as well.
      # See:
      # - https://zmk.dev/docs/features/modules
      # - https://docs.zephyrproject.org/3.5.0/develop/west/manifest.html#projects
    - name: anhuar-ma 
      url-base: https://github.com/anhuar-ma
  projects:
   # - name: mario-peripheral-animation
   #   remote: gpeye
   #    revision: main 
    - name: eyelash_sofle
      url: https://github.com/a741725193/zmk-sofle
      revision: main
    - name: zmk
      remote: anhuar-ma 
      revision: v0.3-branch
      import: app/west.yml

  self:
    path: boards
```
